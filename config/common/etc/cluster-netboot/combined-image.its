## config/common/etc/cluster-netboot/combined-image.its
```
/dts-v1/;
/ {
    description = "ARM cluster boot script container";
    images {
        script@0 {
            description = "ARM cluster boot script";
            data = /incbin/("./u-boot-script.txt");
            type = "script";
            compression = "none";
        };
    };
};
```
